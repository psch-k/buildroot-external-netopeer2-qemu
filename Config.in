## Config.in
```kconfig
source "$BR2_EXTERNAL_NETOPEER2_QEMU_PATH/package/sysrepo-plugin-module-versions/Config.in"
source "$BR2_EXTERNAL_NETOPEER2_QEMU_PATH/package/sysrepo-tsn/Config.in"
source "$BR2_EXTERNAL_NETOPEER2_QEMU_PATH/package/tsntool/Config.in"
```

## configs/netopeer2_qemu_nxp_x86_64_defconfig
```kconfig
BR2_x86_64=y
BR2_GLOBAL_PATCH_DIR="$(BR2_EXTERNAL_NETOPEER2_QEMU_PATH)/board/qemu/x86_64/patches"
BR2_PACKAGE_HOST_LINUX_HEADERS_CUSTOM_4_19=y
BR2_TOOLCHAIN_BUILDROOT_CXX=y
BR2_SYSTEM_DHCP="eth0"
BR2_ROOTFS_POST_BUILD_SCRIPT="$(BR2_EXTERNAL_NETOPEER2_QEMU_PATH)/board/qemu/x86_64/post-build.sh"
BR2_LINUX_KERNEL=y
BR2_LINUX_KERNEL_CUSTOM_GIT=y
BR2_LINUX_KERNEL_CUSTOM_REPO_URL="https://github.com/kontron/linux-smarc-sal28.git"
BR2_LINUX_KERNEL_CUSTOM_REPO_VERSION="$(shell git ls-remote https://github.com/kontron/linux-smarc-sal28.git master | awk '{ print $$1 }')"
BR2_LINUX_KERNEL_USE_CUSTOM_CONFIG=y
BR2_LINUX_KERNEL_CUSTOM_CONFIG_FILE="$(BR2_EXTERNAL_NETOPEER2_QEMU_PATH)/board/qemu_nxp/x86_64/linux.config"
BR2_PACKAGE_RNG_TOOLS=y
BR2_PACKAGE_LIBSSH_OPENSSL=y
BR2_PACKAGE_NETOPEER2_CLI=y
BR2_PACKAGE_NETOPEER2_SERVER=y
BR2_PACKAGE_NETOPEER2_SERVER_TLS=y
BR2_PACKAGE_NETOPEER2_SERVER_SSH=y
BR2_PACKAGE_DROPBEAR=y
BR2_TARGET_ROOTFS_EXT2=y
# BR2_TARGET_ROOTFS_EXT2_SIZE="128M"
# BR2_TARGET_ROOTFS_TAR is not set
BR2_PACKAGE_HOST_QEMU=y
BR2_PACKAGE_HOST_QEMU_SYSTEM_MODE=y
BR2_PACKAGE_SYSREPO_PLUGIN_MODULE_VERSIONS=y
BR2_PACKAGE_PKGCONF=y
BR2_PACKAGE_TSNTOOL=y
BR2_PACKAGE_SYSREPO_TSN=y
```

## configs/netopeer2_qemu_x86_64_defconfig
```kconfig
BR2_x86_64=y
BR2_GLOBAL_PATCH_DIR="$(BR2_EXTERNAL_NETOPEER2_QEMU_PATH)/board/qemu/x86_64/patches"
BR2_TOOLCHAIN_BUILDROOT_GLIBC=y
BR2_PACKAGE_HOST_LINUX_HEADERS_CUSTOM_4_19=y
BR2_TOOLCHAIN_BUILDROOT_CXX=y
BR2_SYSTEM_DHCP="eth0"
BR2_ROOTFS_POST_BUILD_SCRIPT="$(BR2_EXTERNAL_NETOPEER2_QEMU_PATH)/board/qemu/x86_64/post-build.sh"
BR2_ROOTFS_OVERLAY="$(BR2_EXTERNAL_NETOPEER2_QEMU_PATH)/board/qemu/x86_64/rootfs_overlay"
BR2_LINUX_KERNEL=y
BR2_LINUX_KERNEL_CUSTOM_VERSION=y
BR2_LINUX_KERNEL_CUSTOM_VERSION_VALUE="4.19.91"
BR2_LINUX_KERNEL_USE_CUSTOM_CONFIG=y
BR2_LINUX_KERNEL_CUSTOM_CONFIG_FILE="$(BR2_EXTERNAL_NETOPEER2_QEMU_PATH)/board/qemu/x86_64/linux.config"
BR2_PACKAGE_RNG_TOOLS=y
BR2_PACKAGE_DROPBEAR=y
BR2_TARGET_ROOTFS_EXT2=y
# BR2_TARGET_ROOTFS_TAR is not set
BR2_PACKAGE_LIBSSH_OPENSSL=y
BR2_PACKAGE_LIBYANG=y
BR2_PACKAGE_LIBNETCONF2=y
BR2_PACKAGE_SYSREPO_PLUGIN_IETF_INTERFACES=y
BR2_PACKAGE_SYSREPO_PLUGIN_IETF_INTERFACES_DEBUG=y
BR2_PACKAGE_SYSREPO_PLUGIN_MODULE_VERSIONS=y
#BR2_PACKAGE_SYSREPO_TSN=y
BR2_PACKAGE_NETOPEER2=y
BR2_PACKAGE_NETOPEER2_CLI=y
BR2_PACKAGE_HOST_QEMU=y
BR2_PACKAGE_HOST_QEMU_SYSTEM_MODE=y

BR2_PACKAGE_GDB=y
BR2_GDB_VERSION="8.2.1"
# BR2_PACKAGE_GDB_SERVER is not set
BR2_PACKAGE_GDB_DEBUGGER=y
# BR2_PACKAGE_GDB_TUI is not set
BR2_PACKAGE_ROCKER=y
```

## package/rocker/Config.in
```kconfig
config BR2_PACKAGE_ROCKER
	bool "QEMUs switchdev kernel example"

	help
	  Example for developping / testing switchdev functionality.
```

## package/sysrepo-plugin-ietf-interfaces/Config.in
```kconfig
config BR2_PACKAGE_SYSREPO_PLUGIN_IETF_INTERFACES
	bool "Sysrepo-ietf-interfaces"
	select BR2_PACKAGE_LIBGLIB2
	select BR2_PACKAGE_LIBNL
	select BR2_PACKAGE_SYSREPO

	help
	  Sysrepo Plugin for IETF Interfaces.

if BR2_PACKAGE_SYSREPO_PLUGIN_IETF_INTERFACES

config BR2_PACKAGE_SYSREPO_PLUGIN_IETF_INTERFACES_DEBUG
	bool "sysrepo-plugin-ietf-interfaces-debug"
	help
	  Build plugin as executable.

endif
```

## package/sysrepo-plugin-module-versions/Config.in
```kconfig
config BR2_PACKAGE_SYSREPO_PLUGIN_MODULE_VERSIONS
	bool "Sysrepo-module-versions"
	default n
	select BR2_PACKAGE_SYSREPO

	help
	  Sysrepo Plugin for TTTech's module-versions
```

## package/sysrepo-tsn/Config.in
```kconfig
config BR2_PACKAGE_SYSREPO_TSN
	bool "Sysrepo-TSN"
	default n
	select BR2_PACKAGE_SYSREPO
	select BR2_PACKAGE_CJSON
	select BR2_PACKAGE_LIBNL
	select BR2_PACKAGE_LIBNL_TOOLS
	select BR2_PACKAGE_TSNTOOL

	help
	  Sysrepo Plugin for OpenIL TSN
```
